## arch/arm/mach-msm/Kconfig.rej
```kconfig
--- arch/arm/mach-msm/Kconfig
+++ arch/arm/mach-msm/Kconfig
@@ -2338,6 +2338,12 @@
 	help
 	  Krait overclocking up to 1.84 GHz
 
+config CPU_VOLTAGE_TABLE
+	bool "Enable CPU Voltage Table via sysfs for adjustements"
+	default n
+	help
+	  Krait User Votlage Control
+
 config SEC_PERIPHERAL_SECURE_CHK
 	bool "PERIPHERAL SECURE check"
 	help
```

## block/Kconfig.iosched.rej
```kconfig
--- block/Kconfig.iosched
+++ block/Kconfig.iosched
@@ -64,7 +44,6 @@
 config DEFAULT_IOSCHED
 	string
 	default "deadline" if DEFAULT_DEADLINE
-	default "row" if DEFAULT_ROW
 	default "cfq" if DEFAULT_CFQ
 	default "noop" if DEFAULT_NOOP
 
```

## drivers/cpufreq/Kconfig.rej
```kconfig
--- drivers/cpufreq/Kconfig
+++ drivers/cpufreq/Kconfig
@@ -110,6 +110,19 @@
 	  Be aware that not all cpufreq drivers support the conservative
 	  governor. If unsure have a look at the help section of the
 	  driver. Fallback governor will be the performance governor.
+
+config CPU_FREQ_DEFAULT_GOV_HOTPLUG
+	bool "hotplug"
+	select CPU_FREQ_GOV_HOTPLUG
+	select CPU_FREQ_GOV_PERFORMANCE
+	help
+	  Use the CPUFreq governor 'hotplug' as default. This allows you
+	  to get a full dynamic frequency capable system with CPU
+	  hotplug support by simply loading your cpufreq low-level
+	  hardware driver.  Be aware that not all cpufreq drivers
+	  support the hotplug governor. If unsure have a look at
+	  the help section of the driver. Fallback governor will be the
+	  performance governor.
 endchoice
 
 config CPU_FREQ_GOV_PERFORMANCE
@@ -190,4 +203,24 @@
 
 	  If in doubt, say N.
 
+config CPU_FREQ_GOV_HOTPLUG
+	tristate "'hotplug' cpufreq governor"
+	depends on CPU_FREQ && NO_HZ && HOTPLUG_CPU
+	help
+	  'hotplug' - this driver mimics the frequency scaling behavior
+	  in 'ondemand', but with several key differences.  First is
+	  that frequency transitions use the CPUFreq table directly,
+	  instead of incrementing in a percentage of the maximum
+	  available frequency.  Second 'hotplug' will offline auxillary
+	  CPUs when the system is idle, and online those CPUs once the
+	  system becomes busy again.  This last feature is needed for
+	  architectures which transition to low power states when only
+	  the "master" CPU is online, or for thermally constrained
+	  devices.
+
+	  If you don't have one of these architectures or devices, use
+	  'ondemand' instead.
+
+	  If in doubt, say N.
+
 endif	# CPU_FREQ
```

## drivers/gpu/msm/Kconfig.rej
```kconfig
--- drivers/gpu/msm/Kconfig
+++ drivers/gpu/msm/Kconfig
@@ -106,11 +106,3 @@
 config MSM_KGSL_GPU_USAGE
 	bool "Enable sysfs node of GPU usage per process"
 	default n
-
-config MSM_KGSL_SIMPLE_GOV
-	bool "Simple KGSL GPU govenor for Qualcomm Adreno xxx devices"
-	default n
-	depends on MSM_KGSL
-	---help---
-	  A simple KGSL GPU govenor for Qualcom Adreno XXX devices
-
```

## drivers/input/touchscreen/Kconfig.rej
```kconfig
--- drivers/input/touchscreen/Kconfig
+++ drivers/input/touchscreen/Kconfig
@@ -483,10 +483,6 @@
         depends on I2C
         help
           This enables support for Synaptics RMI4 over I2C based touchscreens.
-          
-config TOUCHSCREEN_SYNAPTICS_SWEEP2WAKE
-        tristate "Sweep2Wake for SYNAPTICS_3k based touchscreens"
-        default y
 
 config TOUCHSCREEN_TOUCHRIGHT
 	tristate "Touchright serial touchscreen"
```

## sound/soc/codecs/Kconfig.rej
```kconfig
--- sound/soc/codecs/Kconfig
+++ sound/soc/codecs/Kconfig
@@ -448,9 +448,3 @@
 
 config SND_SOC_MSM_STUB
 	tristate
-
-config SOUND_CONTROL_HAX_GPL
-	tristate "wcd93xx sound control hax"
-	default y
-	help
-	  FauxSound WCD93xx chipset sound control hacks
```
